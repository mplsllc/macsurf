#include <stdio.h>
#include <stdlib.h>
#include <string.h>
#include "quickjs.h"

#ifdef __MWERKS__
/* #include <Carbon.h> */
#endif

/* --- Interrupt Handler --- */
static int mac_js_interrupt_handler(JSRuntime *rt, void *opaque) {
#ifdef __MWERKS__
    EventRecord event;
    if (WaitNextEvent(everyEvent, &event, 0, NULL)) {
        if (event.what == keyDown && (event.modifiers & cmdKey) && ((event.message & charCodeMask) == '.')) {
            return 1; /* Interrupt */
        }
    }
#endif
    return 0; /* Continue execution */
}

/* --- JS Print Function --- */
static JSValue js_print(JSContext *ctx, JSValueConst this_val, int argc, JSValueConst *argv) {
    int i;
    const char *str;
    for(i = 0; i < argc; i++) {
        if (i != 0) printf(" ");
        str = JS_ToCString(ctx, argv[i]);
        if (!str) return JS_EXCEPTION;
        printf("%s", str);
        JS_FreeCString(ctx, str);
    }
    printf("\n");
    return JS_UNDEFINED;
}

static void dump_exception(JSContext *ctx, JSValue exception_val) {
    const char *str;
    int is_error = JS_IsError(exception_val);
    
    str = JS_ToCString(ctx, exception_val);
    if (str) {
        printf("JS Exception: %s\n", str);
        JS_FreeCString(ctx, str);
    }
    if (is_error) {
        JSValue val = JS_GetPropertyStr(ctx, exception_val, "stack");
        if (!JS_IsUndefined(val)) {
            str = JS_ToCString(ctx, val);
            if (str) {
                printf("Stack Trace:\n%s\n", str);
                JS_FreeCString(ctx, str);
            }
        }
        JS_FreeValue(ctx, val);
    }
}

int main(int argc, char **argv) {
    JSRuntime *rt;
    JSContext *ctx;
    JSValue global_obj, val;
    const char *script;

#ifdef __MWERKS__
    InitCursor();
    FlushEvents(everyEvent, 0);
#endif

    printf("========================================\n");
    printf("  QuickJS Sanity Check Suite\n");
    printf("========================================\n\n");

    printf("[System] Initializing Runtime & Context...\n");
    rt = JS_NewRuntime();
    if (!rt) {
        printf("FATAL: Failed to create JSRuntime\n");
        goto wait_exit;
    }

    JS_SetInterruptHandler(rt, mac_js_interrupt_handler, NULL);

    ctx = JS_NewContext(rt);
    if (!ctx) {
        printf("FATAL: Failed to create JSContext\n");
        JS_FreeRuntime(rt);
        goto wait_exit;
    }

    /* Inject print() function into JS global scope */
    global_obj = JS_GetGlobalObject(ctx);
    JS_SetPropertyStr(ctx, global_obj, "print", JS_NewCFunction(ctx, js_print, "print", 1));
    JS_FreeValue(ctx, global_obj);

    script = 
        "print('--- STARTING JS TESTS ---');\n"
        "print('1. Basic Math: 10 * 10 = ' + (10 * 10));\n"
        "print('2. Floating Point (MathLib): Math.sqrt(144) = ' + Math.sqrt(144));\n"
        "print('3. C99 Polyfill (cbrt): Math.cbrt(27) = ' + Math.cbrt(27));\n"
        "print('4. ES6 Arrow Functions & Map: ' + [1, 2, 3].map(x => x * 5).join(', '));\n"
        "print('5. JSON Parsing: ' + JSON.stringify({os: 'Mac OS 9', year: 1999}));\n"
        "try {\n"
        "    throw new Error('Testing exceptions!');\n"
        "} catch(e) {\n"
        "    print('6. Exception Handling: Caught -> ' + e.message);\n"
        "}\n"
        "print('7. Object Destructuring:');\n"
        "const {a, b} = {a: 'Hello', b: 'World'};\n"
        "print('   a: ' + a + ', b: ' + b);\n"
        "print('--- TESTS COMPLETE ---');\n";

    printf("\n[System] Executing Scripts...\n\n");
    val = JS_Eval(ctx, script, strlen(script), "sanity_test.js", JS_EVAL_TYPE_GLOBAL);
    
    if (JS_IsException(val)) {
        JSValue exception_val = JS_GetException(ctx);
        dump_exception(ctx, exception_val);
        JS_FreeValue(ctx, exception_val);
    } else {
        printf("\n[System] Scripts Executed Successfully.\n");
    }

    JS_FreeValue(ctx, val);
    JS_FreeContext(ctx);
    JS_FreeRuntime(rt);

wait_exit:
    printf("\n\nPress ENTER to exit...");
    getchar();
    return 0;
}