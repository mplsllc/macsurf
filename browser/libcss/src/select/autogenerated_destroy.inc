/*
 * This file is part of LibCSS
 * Licensed under the MIT License,
 *                http://www.opensource.org/licenses/mit-license.php
 * Copyright 2017 The NetSurf Project
 */


/* set_align_content(style, 0, 0, CSS_UNIT_PX); */
/* set_align_items(style, 0, 0, CSS_UNIT_PX); */
/* set_align_self(style, 0, 0, CSS_UNIT_PX); */
/* set_background_attachment(style, 0, 0, CSS_UNIT_PX); */
/* set_background_color(style, 0, 0, CSS_UNIT_PX); */
/* set_background_image(style, 0, 0, CSS_UNIT_PX); */
/* set_background_position(style, 0, 0, CSS_UNIT_PX); */
/* set_background_repeat(style, 0, 0, CSS_UNIT_PX); */
/* set_border_bottom_color(style, 0, 0, CSS_UNIT_PX); */
/* set_border_bottom_style(style, 0, 0, CSS_UNIT_PX); */
/* set_border_bottom_width(style, 0, 0, CSS_UNIT_PX); */
/* set_border_collapse(style, 0, 0, CSS_UNIT_PX); */
/* set_border_left_color(style, 0, 0, CSS_UNIT_PX); */
/* set_border_left_style(style, 0, 0, CSS_UNIT_PX); */
/* set_border_left_width(style, 0, 0, CSS_UNIT_PX); */
/* set_border_radius(style, 0, 0, CSS_UNIT_PX); */
/* set_border_right_color(style, 0, 0, CSS_UNIT_PX); */
/* set_border_right_style(style, 0, 0, CSS_UNIT_PX); */
/* set_border_right_width(style, 0, 0, CSS_UNIT_PX); */
/* set_border_spacing(style, 0, 0, CSS_UNIT_PX); */
/* set_border_top_color(style, 0, 0, CSS_UNIT_PX); */
/* set_border_top_style(style, 0, 0, CSS_UNIT_PX); */
/* set_border_top_width(style, 0, 0, CSS_UNIT_PX); */
/* set_bottom(style, 0, 0, CSS_UNIT_PX); */
/* set_box_shadow(style, 0, 0, CSS_UNIT_PX); */
/* set_box_sizing(style, 0, 0, CSS_UNIT_PX); */
/* set_break_after(style, 0, 0, CSS_UNIT_PX); */
/* set_break_before(style, 0, 0, CSS_UNIT_PX); */
/* set_break_inside(style, 0, 0, CSS_UNIT_PX); */
/* set_caption_side(style, 0, 0, CSS_UNIT_PX); */
/* set_clear(style, 0, 0, CSS_UNIT_PX); */
/* set_clip(style, 0, 0, CSS_UNIT_PX); */
/* set_color(style, 0, 0, CSS_UNIT_PX); */
/* set_column_count(style, 0, 0, CSS_UNIT_PX); */
/* set_column_fill(style, 0, 0, CSS_UNIT_PX); */
/* set_column_gap(style, 0, 0, CSS_UNIT_PX); */
/* set_column_rule_color(style, 0, 0, CSS_UNIT_PX); */
/* set_column_rule_style(style, 0, 0, CSS_UNIT_PX); */
/* set_column_rule_width(style, 0, 0, CSS_UNIT_PX); */
/* set_column_span(style, 0, 0, CSS_UNIT_PX); */
/* set_column_width(style, 0, 0, CSS_UNIT_PX); */
/* set_content(style, 0, 0, CSS_UNIT_PX); */
/* set_counter_increment(style, 0, 0, CSS_UNIT_PX); */
/* set_counter_reset(style, 0, 0, CSS_UNIT_PX); */
/* set_cursor(style, 0, 0, CSS_UNIT_PX); */
/* set_direction(style, 0, 0, CSS_UNIT_PX); */
/* set_display(style, 0, 0, CSS_UNIT_PX); */
/* set_empty_cells(style, 0, 0, CSS_UNIT_PX); */
/* set_fill_opacity(style, 0, 0, CSS_UNIT_PX); */
/* set_flex_basis(style, 0, 0, CSS_UNIT_PX); */
/* set_flex_direction(style, 0, 0, CSS_UNIT_PX); */
/* set_flex_grow(style, 0, 0, CSS_UNIT_PX); */
/* set_flex_shrink(style, 0, 0, CSS_UNIT_PX); */
/* set_flex_wrap(style, 0, 0, CSS_UNIT_PX); */
/* set_float(style, 0, 0, CSS_UNIT_PX); */
/* set_font_family(style, 0, 0, CSS_UNIT_PX); */
/* set_font_size(style, 0, 0, CSS_UNIT_PX); */
/* set_font_style(style, 0, 0, CSS_UNIT_PX); */
/* set_font_variant(style, 0, 0, CSS_UNIT_PX); */
/* set_font_weight(style, 0, 0, CSS_UNIT_PX); */
/* set_height(style, 0, 0, CSS_UNIT_PX); */
/* set_justify_content(style, 0, 0, CSS_UNIT_PX); */
/* set_left(style, 0, 0, CSS_UNIT_PX); */
/* set_letter_spacing(style, 0, 0, CSS_UNIT_PX); */
/* set_line_height(style, 0, 0, CSS_UNIT_PX); */
/* set_list_style_image(style, 0, 0, CSS_UNIT_PX); */
/* set_list_style_position(style, 0, 0, CSS_UNIT_PX); */
/* set_list_style_type(style, 0, 0, CSS_UNIT_PX); */
/* set_macsurf_gradient(style, 0, 0, CSS_UNIT_PX); */
/* set_macsurf_text_shadow(style, 0, 0, CSS_UNIT_PX); */
/* set_macsurf_transform(style, 0, 0, CSS_UNIT_PX); */
/* set_margin_bottom(style, 0, 0, CSS_UNIT_PX); */
/* set_margin_left(style, 0, 0, CSS_UNIT_PX); */
/* set_margin_right(style, 0, 0, CSS_UNIT_PX); */
/* set_margin_top(style, 0, 0, CSS_UNIT_PX); */
/* set_max_height(style, 0, 0, CSS_UNIT_PX); */
/* set_max_width(style, 0, 0, CSS_UNIT_PX); */
/* set_min_height(style, 0, 0, CSS_UNIT_PX); */
/* set_min_width(style, 0, 0, CSS_UNIT_PX); */
/* set_opacity(style, 0, 0, CSS_UNIT_PX); */
/* set_order(style, 0, 0, CSS_UNIT_PX); */
/* set_orphans(style, 0, 0, CSS_UNIT_PX); */
/* set_outline_color(style, 0, 0, CSS_UNIT_PX); */
/* set_outline_style(style, 0, 0, CSS_UNIT_PX); */
/* set_outline_width(style, 0, 0, CSS_UNIT_PX); */
/* set_overflow_x(style, 0, 0, CSS_UNIT_PX); */
/* set_overflow_y(style, 0, 0, CSS_UNIT_PX); */
/* set_padding_bottom(style, 0, 0, CSS_UNIT_PX); */
/* set_padding_left(style, 0, 0, CSS_UNIT_PX); */
/* set_padding_right(style, 0, 0, CSS_UNIT_PX); */
/* set_padding_top(style, 0, 0, CSS_UNIT_PX); */
/* set_page_break_after(style, 0, 0, CSS_UNIT_PX); */
/* set_page_break_before(style, 0, 0, CSS_UNIT_PX); */
/* set_page_break_inside(style, 0, 0, CSS_UNIT_PX); */
/* set_position(style, 0, 0, CSS_UNIT_PX); */
/* set_quotes(style, 0, 0, CSS_UNIT_PX); */
/* set_right(style, 0, 0, CSS_UNIT_PX); */
/* set_stroke_opacity(style, 0, 0, CSS_UNIT_PX); */
/* set_table_layout(style, 0, 0, CSS_UNIT_PX); */
/* set_text_align(style, 0, 0, CSS_UNIT_PX); */
/* set_text_decoration(style, 0, 0, CSS_UNIT_PX); */
/* set_text_indent(style, 0, 0, CSS_UNIT_PX); */
/* set_text_transform(style, 0, 0, CSS_UNIT_PX); */
/* set_top(style, 0, 0, CSS_UNIT_PX); */
/* set_unicode_bidi(style, 0, 0, CSS_UNIT_PX); */
/* set_vertical_align(style, 0, 0, CSS_UNIT_PX); */
/* set_visibility(style, 0, 0, CSS_UNIT_PX); */
/* set_white_space(style, 0, 0, CSS_UNIT_PX); */
/* set_widows(style, 0, 0, CSS_UNIT_PX); */
{ css_fixed_or_calc foc_zero_; foc_zero_.value = 0; set_width(style, 0, foc_zero_, CSS_UNIT_PX); }
/* set_word_spacing(style, 0, 0, CSS_UNIT_PX); */
/* set_writing_mode(style, 0, 0, CSS_UNIT_PX); */
/* set_z_index(style, 0, 0, CSS_UNIT_PX); */
